/******************** (C) COPYRIGHT 2012 e-Design Co.,Ltd. *********************
 File Name : Draw.c
 Version   : DS201 Ver 3.0                                       Author : bure
*******************************************************************************/
#include "Draw.h"
#include <string.h>
#include "BIOS.h"
#include "DFU_Func.h"


uc8 DEMO[300] =   //样本波形描述
{100,116,130,144,157,167,175,181,185,185,184,179,173,164,153,141,128,114,100, 86,
  73, 60, 49, 40, 33, 27, 24, 24, 25, 29, 35, 43, 52, 63, 75, 87,100,112,124,135,
 145,153,160,164,167,167,166,163,157,150,142,133,122,111,100, 89, 79, 70, 61, 54,
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  92, 88, 85, 83, 81, 80, 79, 79, 80, 81, 83, 85, 88, 91, 94, 97,100,103,106,108};

uc16 SYMB8x14[]={  // 显示符号图形数据定义
  0x7FF8,0x4008,0x5FE8,0x5208,0x5208,0x5008,0x4008,0x7FF8, // @ 方框 F
  0x0FC0,0x0840,0x7878,0x4008,0x4008,0x4008,0x4008,0x4008, // A 空电池头
  0x4008,0x4008,0x4008,0x4008,0x4008,0x4008,0x4008,0x4008, // B 空电池身
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  0x0000,0x0000,0x0000,0x0000,0x0000,0x0000,0x0000,0x0000}; // _ 空格

uc16 CHAR8x14[]={
  0x0000,0x0000,0x0000,0x0000,0x0000,0x0000,0x0000,0x0000, // _ 0x20
  0x0000,0x0000,0x0000,0x3F30,0x3E30,0x0000,0x0000,0x0000, // !
  0x0000,0x3800,0x3000,0x0000,0x0000,0x0000,0x0000,0x0000, // "
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  0x0100,0x0200,0x0200,0x0100,0x0080,0x0080,0x0100,0x0000};// ~

s16 ParamTab[41] = {// 显示变量参数表
//+======+======+======+======+======+======+======+======+======+======+======+
//   P1F,   P2F,   P3F,   P4F,   VTF,   V1F,   V2F,   T0F,   T1F,   T2F,        消隐项
//+------+------+------+------+------+------+------+------+------+------+------+
   L_HID, L_HID, A_HID, A_HID,  SHOW,  SHOW,  SHOW,  SHOW,  SHOW,  SHOW,
//+======+======+======+======+======+======+======+======+======+======+======+
//  P1x2,  P1x2,  P1x2,  P1x2,  VTx2,  V1x2,  V2x2,  T0x1,  T1x1,  T2x1,        数值项
//+------+------+------+------+------+------+------+------+------+------+------+
     300,   200,   120,    20,   320,   360,    60,   150,    40,   290,
//+======+======+======+======+======+======+======+======+======+======+======+
//   PC1,   PC2,   PC3,   PC4,   VTC,   V1C,   V2C,   T0C,   T1C,   T2C,        颜色项
//+------+------+------+------+------+------+------+------+------+------+------+
     CYN,   PUR,   YEL,   GRN,   GRN,   WHT,   WHT,   ORN,   WHT,   WHT,
//+======+======+======+======+======+======+======+======+======+======+======+
//  PC1_,  PC2_,  PC3_,  PC4_,  BXx1,  WXx1,  BYx2,  HYx2, POP_F, POP_B, POP_C   其它项
//+------+------+------+------+------+------+------+------+------+------+------+
    CYN_,  PUR_,  YEL_,  GRN_,   180,   100,    26,   256, P_HID,   DAR,   WHT };
//+======+======+======+======+======+======+======+======+======+======+======+

u8  WaveBuf[TRACK1_SIZE + TRACK2_SIZE + TRACK23_SIZE + POP_SIZE]; // 显示缓冲区
//u8  PopEn = P_HID, DialogEn = 0, Data[300] = {100};
u8  PopType = DEMO_POP,Data[300] = {100} ;
u8  Cal_flag = 0;

u16 Hy = 128, Wx = 100;       // 弹出窗长宽尺寸
u16 Nx = 5,   Ny = 5;         // 弹出窗当前显示位置
u16 Sx = 0,   Sy = 0;         // 主屏幕当前显示位置
u16 Background, Foreground;   // 主屏幕当前显示颜色
s16 Dx = 1, Dy = 2;

/*******************************************************************************
 PopColor: 弹出窗颜色设置
*******************************************************************************/
void PopColor(u16 Board_Color, u16 Text_Color)
{
  ParamTab[POP_B] = Board_Color;
  ParamTab[POP_T] = Text_Color;
}
/*******************************************************************************
 SetColor: LCD屏幕颜色设置
*******************************************************************************/
void SetColor(u16 Board_Color, u16 Text_Color)
{
  Background = Board_Color;
  Foreground = Text_Color;
}
/*******************************************************************************
 NotePixel: 弹出窗像素设置     Color: 像素颜色(1/0)  像素定位: Nx, Ny
*******************************************************************************/
void NotePixel(u8 Color)
{
  u16 i, j, *pBuf = (u16*)&WaveBuf[300 + 300 + 300];

  Nx = Nx%ParamTab[WXx1];
  Ny = Ny%ParamTab[HYx2];             // Nx, Ny 超界则返回起点
  i  = Nx*(ParamTab[HYx2]/32)+ Ny/16;
  j  = Ny%16;
  if(Color) pBuf[i] |=  1 << j;
  else      pBuf[i] &=~(1 << j);
  Ny++;
}
/*******************************************************************************
  NoteSide: 清除弹出窗内容及画背景框   输入参数: Nx, Ny, Wx, Hy
*******************************************************************************/
void Buil_Pop(void)
{
  u16 i;
  memset(&WaveBuf[TRACK1_SIZE+TRACK2_SIZE+TRACK23_SIZE], BLK, POP_SIZE);
  Nx = 0; Ny = 3; for(i=0; i<ParamTab[HYx2]/2-6; i++) NotePixel(1);
  Nx = 1; Ny = 2;                    NotePixel(1);
  Nx = 1; Ny = ParamTab[HYx2]/2 - 3; NotePixel(1);
  Nx = 2; Ny = 1;                    NotePixel(1);
  Nx = 2; Ny = ParamTab[HYx2]/2 - 2; NotePixel(1);
  for(Nx=3; Nx<ParamTab[WXx1]-2; Nx++){
    Ny = 0;                     NotePixel(1);
    Ny = ParamTab[HYx2]/2 - 1;; NotePixel(1);
  }
  Nx = ParamTab[WXx1]-3; Ny = 1;                    NotePixel(1);
  Nx = ParamTab[WXx1]-3; Ny = ParamTab[HYx2]/2 - 2; NotePixel(1);
  Nx = ParamTab[WXx1]-2; Ny = 2;                    NotePixel(1);
  Nx = ParamTab[WXx1]-2; Ny = ParamTab[HYx2]/2 - 3; NotePixel(1);
  Nx = ParamTab[WXx1]-1; Ny = 3; for(i=0; i<ParamTab[HYx2]/2-6; i++) NotePixel(1);
}
/*******************************************************************************
 NoteChar: 弹出窗内显示字符/图块       Mode = bit0: Normal/Inv, bit1: Char/Symb
*******************************************************************************/
void NoteChar(u8 Mode, u8 Code)
{
  u16 i, j, k;

  for(i=0; i<8; ++i){
    if(Mode & SYMB) k = SYMB8x14[(Code - '@')*8 + i];
    else            k = __Font_8x14(Code, i); // k = CHAR8x14[(Code - ' ')*8 + i];

    if(Mode & VOID) k &= (i%2)? 0xAAAA : 0x5555;
    for(j=0; j<14; ++j){
      if(k & 4)  NotePixel((Mode & INV)? 0 : 1);
      else       NotePixel((Mode & INV)? 1 : 0);
      k >>= 1;
    }
    Nx++; Ny -= 14;
  }
}
/*******************************************************************************
 NoteSTR: 弹出窗内显示字符/图块串      Mode = bit0: Normal/Inv, bit1: Char/Symb
*******************************************************************************/
void NoteSTR(u16 Nx0, u16 Ny0, u8 Mode, u8 *Str)
{
  u8 i;
  Nx = Nx0, Ny = Ny0;
  for (i=0; i<14; i++) NotePixel((Mode & INV)? 1 : 0);
  Nx++,     Ny = Ny0;                            // 每一个字符串前增加一空白列
  while(*Str != 0){
    NoteChar(Mode, *Str++);
  }
}
/*******************************************************************************
 Disp_Char: 主屏幕显示字符/图块         Mode = bit0: Normal/Inv, bit1: Char/Map
*******************************************************************************/
void DispChar(u8 Mode, u8 Code)
{
  u16 i, j, k;

  for(i=0; i<8; ++i){
    if(Mode & SYMB) k = SYMB8x14[(Code - '@')*8 + i];
    else            k = __Font_8x14(Code, i); // k = CHAR8x14[(Code - ' ')*8 + i];
    if(Mode & VOID) k &= (i%2)? 0xAAAA : 0x5555;
    __Set_Posi(Sx, Sy);
    for(j=0; j<14; ++j){
      if(k & 4)  __Set_Pixel((Mode & INV)? Background : Foreground);
      else       __Set_Pixel((Mode & INV)? Foreground : Background);
      k >>= 1;
    }
    Sx++;
  }
}
/*******************************************************************************
  DispStr: 主屏幕显示字符/图块串        Mode = bit0: Normal/Inv, bit1: Char/Map
*******************************************************************************/
void DispStr(u16 x0, u16 y0, u8 Mode, u8 *Str)
{
  u16 i ;
  Sx = x0; Sy = y0;
  __Set_Posi(Sx, Sy);
  for (i=0; i<14; i++) __Set_Pixel((Mode & INV)? Foreground : Background);
  Sx++;                                   // 每一个字符串前增加一空白列
  while(*Str != 0){
    DispChar(Mode, *Str++);
  }
}
/*******************************************************************************
  List_Pop: 打开菜单窗
*******************************************************************************/
void List_Pop(void)
{
  PopType |= LIST_POP;
  ParamTab[POP_F] = SHOW;

}
/*******************************************************************************
  Close_Pop: 关闭菜单窗及会话窗
*******************************************************************************/
void Close_Pop(void)
{
  PopType &= ~(LIST_POP | DAILOG_POP);
  if(!(PopType & DEMO_POP)) ParamTab[POP_F] = P_HID;
  else Demo_Pop();

}
/*******************************************************************************
  Move_Pop: 打开及游动演示窗
*******************************************************************************/
void Demo_Pop(void)
{
  ParamTab[WXx1]= 40;
  ParamTab[HYx2]= 2*48;
  PopColor(BLK, ORN);
  Buil_Pop();
  NoteSTR(4, 26,  PRN, "Demo");
  NoteSTR(4, 10, PRN,  "only");
  ParamTab[POP_F] = SHOW;
  if((ParamTab[BXx1]<= 3)||((ParamTab[BXx1]+ParamTab[WXx1])>= 301)) Dx = -Dx;
  ParamTab[BXx1] += Dx;
  if((ParamTab[BYx2]<= 6)||((ParamTab[BYx2]+ParamTab[HYx2])>= 402)) Dy = -Dy;
  ParamTab[BYx2] += Dy;
}
/*******************************************************************************
  Dialog_Pop: 弹出会话窗
*******************************************************************************/
void Dialog_Pop(u8* Str)
{
  PopType |= DAILOG_POP;
  ParamTab[WXx1]= 16*8;
  ParamTab[HYx2]= 2*3*16;
  ParamTab[BXx1]= 50;
  ParamTab[BYx2]= 200;
  PopColor(DAR, WHT);
  Buil_Pop();
  NoteSTR( 1*8, 26, PRN, Str);
  NoteSTR( 1*8, 10, SYMB,  "PQ");
  NoteSTR( 3*8, 10, PRN,  ":Yes");
  NoteSTR(10*8, 10, SYMB,  "MN");
  NoteSTR(12*8, 10, PRN,  ":No");
  ParamTab[POP_F] = SHOW;
}
/*******************************************************************************
  Calibrate_Pop: 弹出会话窗
*******************************************************************************/
void Calibrate_Pop(u8* Str)
{
  PopType |= DAILOG_POP;
  ParamTab[WXx1]= 25*8;
  ParamTab[HYx2]= 4*16;
  ParamTab[BXx1]= 50;
  ParamTab[BYx2]= 230;
  PopColor(DAR, WHT);
  Buil_Pop();
  NoteSTR( 1*8, 10, PRN, Str);
  ParamTab[POP_F] = SHOW;
}
/*******************************************************************************
  Dialog_Pop: 弹出会话窗
*******************************************************************************/
void CalSave_Pop(u8* Str)
{
  PopType |= DAILOG_POP;
  ParamTab[WXx1]= 30*8;
  ParamTab[HYx2]= 6*16;
  ParamTab[BXx1]= 30;
  ParamTab[BYx2]= 200;
  PopColor(DAR, WHT);
  Buil_Pop();
  NoteSTR( 1*8, 28, PRN, "Complete Cal,");
  NoteSTR( 15*8, 28, PRN, Str);
  NoteSTR( 5*8, 6, SYMB,  "PQ");
  NoteSTR( 7*8, 6, PRN,  ":Yes");
  NoteSTR(20*8, 6, SYMB,  "MN");
  NoteSTR(22*8, 6, PRN,  ":No");
  ParamTab[POP_F] = SHOW;
}
/******************************** END OF FILE *********************************/
